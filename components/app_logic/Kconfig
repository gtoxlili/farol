## components/app_logic/Kconfig
```kconfig
menu "Farol"

    config FAROL_DEMO
        bool "Start on the built-in demo fleet"
        default n
        help
            Development and measurement builds: the board runs sample agents
            from boot and never connects to Paseo, so it can be watched and
            measured without a daemon or anyone at the board. Leave off in
            builds for use.

    config FAROL_BENCH
        bool "Frame benchmark harness (scripted touch, BENCH lines)"
        default n
        select FAROL_DEMO
        help
            Measurement builds: replaces the touch panel with a scripted
            gesture timeline, wraps the presenter to time every frame and
            prints BENCH lines per phase for three runs (components/app_bench).
            Turns on the demo fleet. Leave off in builds for use.

endmenu
```
